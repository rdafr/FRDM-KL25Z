//ADC DRIVER EXAMPLE


//******IMPORTANT******//
//ADC0_RA: ADC0 RESULT A
//ADC0_RB: ADC0 RESULT B
//ADC0_SC2: SOFTWARE TRIGGER
//SOPT7: HARDWARE TRIGGER 
	
#include "MKL25Z4.h" // Device header

#define LED_RED 18
#define LED_GREEN 19
#define LED_BLUE 1

#define AD0 0

uint16_t result = 0;

int main()
{
	//ENABLE ADC CLOCK GATE
	SIM->SCGC6 |= (1 << SIM_SCGC6_ADC0_SHIFT);
	
	//SOFTWARE TRIGGER ENABLED
	ADC0_SC2 &= ~(1 << ADC_SC2_ADTRG_SHIFT);
	
	//CONFIGURING ADC0
	ADC0_CFG1 |= ADC_CFG1_ADLSMP(1) | ADC_CFG1_ADIV(3) | ADC_CFG1_MODE(3) | ADC_CFG1_ADICLK(0);
	
	//CONFIGURING PORTE, THAT REPRESENT SOME ADC CHANNELS, AND PORT(B,D)
	SIM->SCGC5 |= (1 << SIM_SCGC5_PORTE_SHIFT) | (1 << SIM_SCGC5_PORTD_SHIFT) | (1 << SIM_SCGC5_PORTB_SHIFT);
	PORTE->PCR[AD0] = 0; //DEFINE PE0 AS AN ANALOG PIN
	
	//DEFINE LED PINS AS GPIOs
	PORTD->PCR[LED_BLUE] = 0x100; 
	PORTB->PCR[LED_RED] = 0x100; 
	PORTB->PCR[LED_GREEN] = 0x100; 
	
	//DEFINE LED PINS AS OUTPUTS
	GPIOD->PDDR |= (1 << LED_BLUE); 
	GPIOB->PDDR |= (1 << LED_RED); 
	GPIOB->PDDR |= (1 << LED_GREEN); 
	
	//CLEARING LEDS
	GPIOD->PSOR |= (1 << LED_BLUE); 
	GPIOB->PSOR |= (1 << LED_RED); 
	GPIOB->PSOR |= (1 << LED_GREEN); 	
	
	ADC0_SC1A |= ADC_SC1_ADCH(31); //DISABLE ADCH
	
  while(1)
	{
		ADC0_SC1A = ADC_SC1_ADCH(AD0); //STARTING CONVERSION ON CH0
		
		while(!(ADC0_SC2 & (1 << ADC_SC2_ADACT_SHIFT))); //CHECK IF CONVERSION IS IN PROGRESS
		
		while(!(ADC0_SC1A & (1 << ADC_SC1_COCO_SHIFT))); //CHECK IF CONVERSION IS COMPLETE
		
		result = ADC0_RA; //STORAGE ADC READ
		
		if(result > 100)
		{
			GPIOB->PCOR |= (1 << LED_RED);
			GPIOB->PSOR |= (1 << LED_GREEN);
		}	
		else
		{
			GPIOB->PSOR |= (1 << LED_RED);
			GPIOB->PCOR |= (1 << LED_GREEN);
		}	
	}	
}
